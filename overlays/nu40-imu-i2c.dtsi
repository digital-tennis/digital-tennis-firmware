/* External-IMU application adaptation; keep the vendored board DTS intact.
 * Its default group incorrectly requests low-power disconnected inputs.
 * Keep the existing reviewed logical bus pins, activate them in default mode,
 * and disconnect BOTH pins in sleep mode. Physical header still needs review. */
&i2c0_default {
 group1 { /delete-property/ low-power-enable; };
};
&i2c0_sleep {
 group1 {
  psels = <NRF_PSEL(TWIM_SCL, 0, 21)>, <NRF_PSEL(TWIM_SDA, 0, 22)>;
  low-power-enable;
 };
};
